## dts/bindings/modem/simcom,sim7600.yaml
```yaml
# Copyright (C) 2021 metraTec GmbH
# SPDX-License-Identifier: Apache-2.0

description: Simcom Sim7500/7600 modem

compatible: "simcom,sim7600"

include: zephyr,cellular-modem-device.yaml

properties:
  mdm-disable-gpios:
    type: phandle-array
```
